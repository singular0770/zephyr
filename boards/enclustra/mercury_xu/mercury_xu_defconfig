## boards/enclustra/mercury_xu/mercury_xu_defconfig
```kconfig
# Copyright (c) 2020, Antmicro

# Enable UART driver
CONFIG_SERIAL=y

# Enable console
CONFIG_CONSOLE=y
CONFIG_UART_CONSOLE=y

# Enable timer
CONFIG_SYS_CLOCK_TICKS_PER_SEC=1000

# Relocate vector table
CONFIG_ROMSTART_RELOCATION_ROM=y
CONFIG_ROMSTART_REGION_ADDRESS=0x00000000
```

## boards/shields/pcal9722hn_ard/Kconfig.shield
```kconfig
# Copyright (c) 2025 Michael Estes
# SPDX-License-Identifier: Apache-2.0

config SHIELD_PCAL9722HN_ARD
	def_bool $(shields_list_contains,pcal9722hn_ard)
```

## drivers/led/Kconfig.ktd202x
```kconfig
# Copyright (c) 2025 Michael Estes
# SPDX-License-Identifier: Apache-2.0

config KTD202X
	bool "KTD202X LED driver"
	default y
	depends on DT_HAS_KINETIC_KTD202X_ENABLED
	select I2C
	help
	  Enable driver for the Kinetic KTD2026/2027 family of LED
	  controllers.
```

## dts/bindings/led/kinetic,ktd202x.yaml
```yaml
# Copyright (c) 2025 Michael Estes
# SPDX-License-Identifier: Apache-2.0

description: |
  KTD202x 3 or 4 channel LED driver

compatible: "kinetic,ktd202x"

include: i2c-device.yaml
```

## samples/drivers/led/ktd202x/sample.yaml
```yaml
sample:
  description: Demonstration of the KTD202X LED driver
  name: KTD202X sample
tests:
  sample.drivers.led.ktd2026:
    depends_on: arduino_i2c
    build_only: true
    tags: LED
```
