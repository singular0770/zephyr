## boards/avnet/zub1cg_r5/zub1cg_r5_defconfig
```kconfig
CONFIG_XIP=n

CONFIG_ISR_STACK_SIZE=512
CONFIG_THREAD_STACK_INFO=y

CONFIG_SERIAL=y

CONFIG_GPIO=y

CONFIG_CONSOLE=y
CONFIG_UART_CONSOLE=y

CONFIG_UART_XLNX_PS=y

CONFIG_SYS_CLOCK_HW_CYCLES_PER_SEC=100000000
CONFIG_SYS_CLOCK_TICKS_PER_SEC=1000
CONFIG_ARM_MPU=y

CONFIG_ROMSTART_RELOCATION_ROM=y

CONFIG_I2C=y
CONFIG_EEPROM=y
```

## drivers/sensor/memsic/mc6470/Kconfig
```kconfig
# SPDX-License-Identifier: Apache-2.0
#
# Copyright (c) 2025 Michael Estes

menuconfig MC6470
	bool "MC6470 accelerometer driver"
	default y
	depends on DT_HAS_MEMSIC_MC6470_ACCEL_ENABLED
	select I2C if $(dt_compat_on_bus,$(DT_COMPAT_MEMSIC_MC6470_ACCEL),i2c)
	help
	 Enable driver for MC6470 accelerometer.

if MC6470

config MC6470_TRIGGER
	bool "Trigger mode"
	depends on GPIO
	depends on $(dt_compat_any_has_prop,$(DT_COMPAT_MEMSIC_MC6470_ACCEL),irq-gpios)

choice MC6470_TRIGGER_MODE
	prompt "Trigger mode"
	default MC6470_TRIGGER_NONE
	help
	  Specify the type of triggering to be used by the driver.

config MC6470_TRIGGER_NONE
	bool "No trigger"

config MC6470_TRIGGER_OWN_THREAD
	bool "Use own thread"
	select MC6470_TRIGGER
	help
	 Enable trigger to run in own thread. By
	 default it is global thread mode.

endchoice # MC6470_TRIGGER_MODE

if MC6470_TRIGGER

config MC6470_TAP_TRIGGER
	bool "Tap detection"
	default n

config MC6470_THREAD_PRIORITY
	int "Own thread priority"
	depends on MC6470_TRIGGER_OWN_THREAD
	default 10

config MC6470_THREAD_STACK_SIZE
	int "Own thread stask size"
	depends on MC6470_TRIGGER_OWN_THREAD
	default 1024

endif # MC6470_TRIGGER

endif # MC6470
```

## dts/bindings/sensor/memsic,mc6470-accel.yaml
```yaml
# SPDX-License-Identifier: Apache-2.0
# Copyright (c) 2025 Michael Estes

description: MEMSIC/MCube MC6470 I2C accelerometer

compatible: "memsic,mc6470-accel"

include: [sensor-device.yaml, i2c-device.yaml]

properties:
  irq-gpios:
    type: phandle-array

  odr:
    type: string
    description: |
      The sample rate in hertz. Only the following values are allowed:
        32    (default; chip reset value)
        16
        8
        4
        2
        1
        0.5
        0.25
        64
        128
        256
    default: "32"
    enum:
      - "32"
      - "16"
      - "8"
      - "4"
      - "2"
      - "1"
      - "0.5"
      - "0.25"
      - "64"
      - "128"
      - "256"

  range:
    type: int
    description: |
      The range of measurement in G's
    default: 2
    enum:
      - 2    # +/- 2G (default)
      - 4    # +/- 4G
      - 8    # +/- 8G
      - 16   # +/- 16G

  resolution:
    type: int
    description: |
      The resolution of measurement in bits
    default: 6
    enum:
      - 6   # (default)
      - 7
      - 8
      - 10
      - 12
      - 14
```
